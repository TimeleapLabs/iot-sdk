## CMakeLists.txt
```
# SPDX-License-Identifier: Apache-2.0

cmake_minimum_required(VERSION 3.20.0)
set(DTC_OVERLAY_FILE app.overlay)

find_package(Zephyr REQUIRED HINTS $ENV{ZEPHYR_BASE})
project(app)

target_include_directories(app PRIVATE ${CMAKE_BINARY_DIR}/app/include src)

FILE(GLOB app_sources src/*.c)
target_sources(app PRIVATE ${app_sources})
```

## Kconfig
```
module = PROJECT
module-str = project
source "subsys/logging/Kconfig.template.log_config"
source "Kconfig.zephyr"
```

## prj.conf
```kconfig
CONFIG_NETWORKING=y

CONFIG_NET_TX_STACK_SIZE=2048
CONFIG_NET_RX_STACK_SIZE=2048

CONFIG_NET_PKT_RX_COUNT=10
CONFIG_NET_PKT_TX_COUNT=10
CONFIG_NET_BUF_RX_COUNT=20
CONFIG_NET_BUF_TX_COUNT=20
CONFIG_NET_MAX_CONTEXTS=10

# Required for getaddrinfo
CONFIG_MINIMAL_LIBC_MALLOC_ARENA_SIZE=8192

CONFIG_NET_TCP=y
CONFIG_INIT_STACKS=y

CONFIG_WIFI=y

CONFIG_NETWORKING=y
CONFIG_NET_L2_ETHERNET=y

CONFIG_NET_IPV6=n
CONFIG_NET_IPV4=y
CONFIG_NET_DHCPV4=y

# Enable WiFi events
CONFIG_NET_MGMT=y
CONFIG_NET_MGMT_EVENT=y

#Enable DNS Resolver
CONFIG_DNS_RESOLVER=y
CONFIG_DNS_SERVER_IP_ADDRESSES=y
CONFIG_DNS_SERVER1="8.8.8.8"
CONFIG_DNS_SERVER2="192.168.1.1"

# HTTP
CONFIG_HTTP_CLIENT=y

# TLS configuration
CONFIG_MBEDTLS=y
CONFIG_MBEDTLS_BUILTIN=y
CONFIG_MBEDTLS_ENABLE_HEAP=y
CONFIG_MBEDTLS_HEAP_SIZE=40000
CONFIG_MBEDTLS_SERVER_NAME_INDICATION=y

# Required for AWS root ca
CONFIG_MBEDTLS_SSL_MAX_CONTENT_LEN=8192

# Enable TLS
CONFIG_NET_SOCKETS_SOCKOPT_TLS=y
CONFIG_NET_SOCKETS_TLS_MAX_CONTEXTS=6

# Sockets
CONFIG_NET_SOCKETS=y
CONFIG_NET_SOCKETS_POLL_MAX=4
CONFIG_NET_SOCKETS_POSIX_NAMES=y

CONFIG_MAIN_STACK_SIZE=16384
CONFIG_HEAP_MEM_POOL_SIZE=40000

CONFIG_KENSHI=y
CONFIG_KENSHI_LOG_LEVEL_DBG=y

CONFIG_LOG=y
CONFIG_PROJECT_LOG_LEVEL_DBG=y
```

## app.overlay
```dts
/*
 * Copyright (c) 2022 Espressif Systems (Shanghai) Co., Ltd.
 * Copyright (c) 2023 Kenshi
 *
 * SPDX-License-Identifier: Apache-2.0
 */

&wifi {
	status = "okay";
};
```

## src/main.c
```c
/*
 * Copyright (c) 2016 Intel Corporation.
 * Copyright (c) 2023 Kenshi
 *
 * SPDX-License-Identifier: Apache-2.0
 */

#include <errno.h>
#include <zephyr/kernel.h>

#include <inttypes.h>
#include <stdio.h>

#include <zephyr/drivers/gpio.h>

#include <zephyr/logging/log.h>
#include <zephyr/net/net_event.h>
#include <zephyr/net/net_if.h>
#include <zephyr/net/net_mgmt.h>
#include <zephyr/net/wifi.h>
#include <zephyr/net/wifi_mgmt.h>

#include <kenshi/kenshi.h>

#include "config.h"

LOG_MODULE_REGISTER(project, CONFIG_PROJECT_LOG_LEVEL);

static int connected;
static struct net_mgmt_event_callback wifi_shell_mgmt_cb;

static void handle_wifi_connect_result(struct net_mgmt_event_callback *cb) {
  const struct wifi_status *status = (const struct wifi_status *)cb->info;

  if (status->status) {
    LOG_INF("Connection request failed (%d).", status->status);
  } else {
    LOG_INF("WIFI Connected.");
    struct net_if *iface = net_if_get_default();
  }
}

static void wifi_mgmt_event_handler(struct net_mgmt_event_callback *cb,
                                    uint32_t mgmt_event, struct net_if *iface) {
  switch (mgmt_event) {
  case NET_EVENT_WIFI_CONNECT_RESULT:
    handle_wifi_connect_result(cb);
    break;
  case NET_EVENT_IPV4_ADDR_ADD:

    char hr_addr[NET_IPV4_ADDR_LEN];
    LOG_INF("IP obtained.");

    for (int i = 0; i < NET_IF_MAX_IPV4_ADDR; i++) {

      struct net_if_addr *if_addr = &iface->config.ip.ipv4->unicast[i];

      if (if_addr->addr_type != NET_ADDR_DHCP || !if_addr->is_used) {
        continue;
      }

      LOG_INF("IPv4 address: %s.",
              net_addr_ntop(AF_INET, &if_addr->address.in_addr, hr_addr,
                            NET_IPV4_ADDR_LEN));

      connected = 1;
      break;
    }
    break;
  default:
    break;
  }
}

void wifi_connect(void) {
  int nr_tries = 10;
  int ret = 0;

  net_mgmt_init_event_callback(&wifi_shell_mgmt_cb, wifi_mgmt_event_handler,
                               NET_EVENT_IPV4_ADDR_ADD);

  net_mgmt_add_event_callback(&wifi_shell_mgmt_cb);

  struct net_if *iface = net_if_get_default();

  net_dhcpv4_start(iface);

  static struct wifi_connect_req_params cnx_params = {
      .ssid = AUTO_CONNECT_SSID,
      .ssid_length = 0,
      .psk = AUTO_CONNECT_PSK,
      .psk_length = 0,
      //.sae_password = AUTO_CONNECT_PSK,
      //.sae_password_length = 0,
      .channel = 0,
      .security = WIFI_SECURITY_TYPE_PSK,
  };

  cnx_params.ssid_length = strlen(AUTO_CONNECT_SSID);
  cnx_params.psk_length = strlen(AUTO_CONNECT_PSK);
  // cnx_params.sae_password_length = strlen(AUTO_CONNECT_PSK);

  connected = 0;

  LOG_INF("Trying to connect to %s...", AUTO_CONNECT_SSID);

  /* Let's wait few seconds for the wifi device to be on-line */
  while (nr_tries-- > 0) {
    ret = net_mgmt(NET_REQUEST_WIFI_CONNECT, iface, &cnx_params,
                   sizeof(struct wifi_connect_req_params));
    if (ret == 0) {
      break;
    }

    LOG_ERR("Connect request failed %d. Waiting for iface...", ret);
    k_msleep(500);
  }

  LOG_INF("Connection requested.");
}

MQL_INIT(kenshi_query, 16, from, to, amount);

MQL_CALLBACK(kenshi_query, entries) {
  printk("------- Event --------\n");
  printk("block.hash: %s\n", entries[0].block.hash);
  printk("block.address: %s\n", entries[0].block.address);
  printk("block.number: %" PRIu64 "\n", entries[0].block.number);
  printk("transaction.hash: %s\n", entries[0].transaction.hash);
  printk("transaction.index: %s\n", entries[0].transaction.index);
  printk("log.index: %s\n", entries[0].log.index);
  printk("event.name: %s\n", entries[0].event.name);
  printk("event.signature: %s\n", entries[0].event.signature);
  printk("event.args.to: %s\n", entries[0].event.args.to);
  printk("event.args.from: %s\n", entries[0].event.args.from);
  printk("event.args.amount: %s\n", entries[0].event.args.amount);
}

void main(void) {

  wifi_connect();

  while (!connected) {
    k_msleep(500);
  }

  MQL_QUERY(kenshi_query, query_string,
            {.blockchain = "binance-mainnet",
             .apikey = MQL_API_KEY,
             .owner = MQL_API_KEY_OWNER,
             .query = {
                 .block_address = "0x42f9c5a27a2647a64f7d3d58d8f896c60a727b0f",
                 .block_number = {.gte = 17633890, .lte = 17633892},
             }});

  MQL_GET_EVENTS(kenshi_query, query_string, 2048);
}
```

## src/config.h
```c
#define AUTO_CONNECT_SSID "WIFI_SSID_HERE"
#define AUTO_CONNECT_PSK "WIFI_PSK_HERE"

// Dummy API keys, replace with yours
#define MQL_API_KEY "fSDjCXCTyq+cx7+HLXKBA5oGIfqyMwztb+0/7pvTK8I="
#define MQL_API_KEY_OWNER "0x51DD193630806aDCFFa9E72569a71A9c12591C33"
```
