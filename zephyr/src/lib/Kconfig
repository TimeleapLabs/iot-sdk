## zephyr/src/lib/Kconfig
```kconfig
# Copyright (c) 2021 Legrand North America, LLC.
# Copyright (c) 2023 Kenshi
# SPDX-License-Identifier: Apache-2.0

menu "Libraries"

rsource "kenshi/Kconfig"

endmenu
```

## zephyr/src/lib/kenshi/Kconfig
```kconfig
# Copyright (c) 2021, Legrand North America, LLC.
# Copyright (c) 2023 Kenshi
# SPDX-License-Identifier: Apache-2.0

config KENSHI
	bool "kenshi Support"
	help
	  This option enables the kenshi library

module = KENSHI
module-str = kenshi
source "subsys/logging/Kconfig.template.log_config"
```
